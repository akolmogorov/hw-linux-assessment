## conf/bblayers.conf
```bitbake
# POKY_BBLAYERS_CONF_VERSION is increased each time build/conf/bblayers.conf
# changes incompatibly
POKY_BBLAYERS_CONF_VERSION = "2"

BBPATH = "${TOPDIR}"
BBFILES ?= ""

BBLAYERS ?= " \
  /home/knuth/poky/meta \
  /home/knuth/poky/meta-poky \
  /home/knuth/poky/meta-yocto-bsp \
  /home/knuth/poky/meta-raspberrypi \
  "
```
